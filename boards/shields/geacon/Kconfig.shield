## config/boards/shields/geacon/Kconfig.defconfig
```kconfig
if SHIELD_GEACON
  config ZMK_KEYBOARD_NAME
  default "geacon"
endif

config SPI
    default y
```

## config/boards/shields/geacon_jis/Kconfig.defconfig
```kconfig
if SHIELD_GEACON_JIS
  config ZMK_KEYBOARD_NAME
  default "geacon_JIS"
endif

config SPI
    default y
```
